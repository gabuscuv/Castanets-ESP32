## controller/sdkconfig.defaults
```kconfig
# TODO: Pending to Configure
## Serial mode
CONFIG_TINYUSB_CDC_ENABLED=y
## HID mode
# CONFIG_TINYUSB_HID_COUNT=1

CONFIG_ESP_CONSOLE_UART_DEFAULT=y
CONFIG_ESP_CONSOLE_UART_BAUDRATE=115200

## BLUETOOTH SUPPORT
CONFIG_BT_ENABLED=y
CONFIG_BT_BLUEDROID_ENABLED=y
## JOYCONs DOESN'T USE BLE
# CONFIG_BT_BLE_ENABLED=y
# CONFIG_BT_BLE_42_FEATURES_SUPPORTED=y
```
